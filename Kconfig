## Kconfig
```kconfig
config ENABLE_MAKER_DESKTOP_SAMPLE
    bool "Enable the Sample of maker-desktop"
    default y
    depends on SAMPLE_ENABLE
if ENABLE_MAKER_DESKTOP_SAMPLE
    orsource "./maker-desktop/Kconfig"
endif

config ENABLE_USB-UART_SAMPLE
    bool
    prompt "Enable the Sample of USB-UART."
    default n
    depends on SAMPLE_ENABLE
    help
        This option means enable the sample of USB-UART.

if ENABLE_USB-UART_SAMPLE
    orsource "./usb-uart/Kconfig"
endif





config ENABLE_PERIPHERAL_SAMPLE
    bool
    prompt "Enable the Sample of peripheral."
    default n
    depends on SAMPLE_ENABLE
    help
        This option means enable the sample of peripheral.

if ENABLE_PERIPHERAL_SAMPLE
    osource "application/samples/peripheral/Kconfig"
endif

config ENABLE_WIFI_SAMPLE
    bool
    prompt "Enable the Sample of WIFI."
    default n
    depends on SAMPLE_ENABLE
    help
        This option means enable the sample of WIFI.

if ENABLE_WIFI_SAMPLE
    osource "application/samples/wifi/Kconfig"
endif

config ENABLE_PRODUCTS_SAMPLE
    bool
    prompt "Enable the Sample of products."
    default n
    depends on SAMPLE_ENABLE
    help
        This option means enable the sample of products.

if ENABLE_PRODUCTS_SAMPLE
    osource "application/samples/products/Kconfig"
endif
```

## keypad/Kconfig
```kconfig
config KEYPAD_DEBUG
    bool "是否包含调试代码（暂只有UART打印）"
    default n
    depends on ENABLE_KEYPAD_SAMPLE
```

## keypad_1v8/sle_uart_1v8/Kconfig
```kconfig
#===============================================================================
# @brief    Kconfig file.
# Copyright (c) @CompanyNameMagicTag 2023-2023. All rights reserved.
#===============================================================================

config SLE_UART_BUS
    int
    prompt "Set the UART BUS of the currrent sample."
    default 0
    depends on ENABLE_KEYPAD_1V8_SAMPLE
    help
        This option means the UART BUS of the currrent sample.

config UART_TXD_PIN
    int
    prompt "Choose UART TXD pin."
    depends on ENABLE_KEYPAD_1V8_SAMPLE
    default 17

config UART_RXD_PIN
    int
    prompt "Choose UART RXD pin."
    depends on ENABLE_KEYPAD_1V8_SAMPLE
    default 18

choice
    prompt "Select sle uart type"
    default SAMPLE_SUPPORT_SLE_UART_SERVER_1V8
    config SAMPLE_SUPPORT_SLE_UART_SERVER_1V8
        bool "Enable SLE UART Server sample."
    config SAMPLE_SUPPORT_SLE_UART_CLIENT_1V8
        bool "Enable SLE UART Client sample."
endchoice


config SUPPORT_SLE_PERIPHERAL
    bool
    default y if (SAMPLE_SUPPORT_SLE_UART_SERVER_1V8)


config SUPPORT_SLE_CENTRAL
    bool
    default y if (SAMPLE_SUPPORT_SLE_UART_CLIENT_1V8)
```

## maker-desktop/Kconfig
```kconfig
# device / health
choice
    prompt "device / health"
    depends on ENABLE_MAKER_DESKTOP_SAMPLE
    default DEVICE


    menuconfig DEVICE
        bool "device"
        select HEALTH_NONE
        orsource "./device/Kconfig"


    menuconfig HEALTH
        bool "health"
        select DEVICE_NONE
        orsource "./health/Kconfig"
endchoice




orsource "./comm/Kconfig"
```

## maker-desktop/comm/Kconfig
```kconfig
menu "communication"
	comment "数据格式"

	config COMM_FORMAT_CTRL
		bool "【控制指令】格式"
		depends on DEVICE_DYNAMIC_KNOB || DEVICE_HEALTH_LAMP || DEVICE_TRINITY_SOUND

	menuconfig COMM_FORMAT_HID
		bool "【HID】格式"
		depends on DEVICE_DYNAMIC_KNOB || DEVICE_KEYBOARD || DEVICE_KEYPAD || DEVICE_MOUSE || TEST_KEYTEST
		if COMM_FORMAT_HID
			choice
				prompt "HID 芯片"
				default COMM_FORMAT_HID_CH9329
				config COMM_FORMAT_HID_CH9329
					bool "通过【CH9329】芯片"
				# config COMM_FORMAT_HID_XXX
				# 	bool "通过【XXX】芯片"
			endchoice
		endif

	config COMM_FORMAT_PERSON
		bool "【个人数据】格式"
		depends on DEVICE_DYNAMIC || DEVICE_HEALTH



	comment "通讯方式"

	config COMM_I2C
		bool "【I2C】方式"
		depends on DEVICE_HEALTH

	config COMM_I2S
		bool "【I2S】方式"
		depends on DEVICE_TRINITY_SOUND # || TEST_TMP

	config COMM_SPI
		bool "【SPI】方式"
		depends on DEVICE_KEYBOARD || DEVICE_KEYPAD || TEST_KEYTEST

	config COMM_UART
		bool "【UART】方式"
		depends on !TEST_TMP

	menuconfig COMM_SLE
		bool "【SLE】方式"
		# depends on !TEST_TMPTEST		// # tmp!!!
		if COMM_SLE
			config COMM_SLE_CLIENT
				bool "【client】模式"
				depends on DEVICE_RECEIVER
			config COMM_SLE_SERVER
				bool "【server】模式"
				depends on !DEVICE_RECEIVER
		endif

	config COMM_WIFI
		bool "【WIFI】方式"
		depends on DEVICE_RECEIVER
endmenu
```

## maker-desktop/device/Kconfig
```kconfig
choice
	prompt "device"
	depends on DEVICE
	default DEVICE_KEYBOARD

	menuconfig DEVICE_DESKAIDE
		bool "deskaide"
		orsource "./deskaide/Kconfig"
		# help
		# 	[uart] & [sle_s]
		# 	[usb-hub] & [音响] & [vfd]

	menuconfig DEVICE_DYNAMIC
		bool "dynamic"
		orsource "./dynamic/Kconfig"
		# help
		# 	[uart] & [sle_s] & [wifi]
		# 	[knob] & [nfc] & [指]

	menuconfig DEVICE_HEALTH
		bool "health"
		orsource "./health/Kconfig"
		# help
		# 	[uart] & [i2c] & [wifi]
		# 	[心] & [温] & [距]

	config DEVICE_KEYBOARD
		bool "keyboard"
		select COMM_FORMAT_HID
		select COMM_I2C
		select COMM_SPI
		select COMM_UART
		select COMM_SLE
		select COMM_SLE_SERVER
		help
			[i2c] & [spi] & [uart] & [sle_s]
		if DEVICE_KEYBOARD
			config PIN_SCL
				int "SCL pin"
				default 18
			config PIN_SDA
				int "SDA pin"
				default 17
		endif

	config DEVICE_KEYPAD
		bool "keypad"
		select COMM_FORMAT_HID
		select COMM_SPI
		select COMM_UART
		select COMM_SLE
		select COMM_SLE_SERVER
		help
			[spi] & [uart] & [sle_s]

	config DEVICE_MOUSE
		bool "mouse"
		select COMM_FORMAT_HID
		select COMM_UART
		select COMM_SLE
		select COMM_SLE_SERVER
		help
			[uart] & [sle_s]

	config DEVICE_RECEIVER
		bool "receiver"
		select COMM_UART
		select COMM_SLE
		select COMM_SLE_CLIENT
		select COMM_WIFI
		help
			[uart] & [sle_c]
endchoice
```

## maker-desktop/device/dynamic/Kconfig
```kconfig
if DEVICE_DYNAMIC
	config DEVICE_DYNAMIC_FINGERPRINT
		bool "fingerprint"
		default y
		select COMM_FORMAT_PERSON
		select COMM_UART
		select COMM_SLE
		select COMM_SLE_SERVER

	config DEVICE_DYNAMIC_KNOB
		bool "knob"
		default y
		select COMM_FORMAT_CTRL
		select COMM_FORMAT_HID
		select COMM_UART
		select COMM_SLE
		select COMM_SLE_SERVER

	config DEVICE_DYNAMIC_NFC
		bool "nfc"
		default y
		select COMM_FORMAT_PERSON
		select COMM_UART
		select COMM_SLE
		select COMM_SLE_SERVER
endif
```

## maker-desktop/device/health/Kconfig
```kconfig
if DEVICE_HEALTH
	menuconfig DEVICE_HEALTH_DISTANCE
		bool "distance"
		default y
		select COMM_FORMAT_PERSON
		select COMM_I2C
		select COMM_SLE
		select COMM_SLE_SERVER

		if DEVICE_HEALTH_DISTANCE
			config PIN_SCL
				int "SCL pin"
				default 0
			config PIN_SDA
				int "SDA pin"
				default 2
		endif

	config DEVICE_HEALTH_LAMP
		bool "lamp"
		default y
		select COMM_FORMAT_CTRL
		select COMM_SLE
		select COMM_SLE_SERVER

	config DEVICE_HEALTH_RATE
		bool "rate"
		default y
		select COMM_FORMAT_PERSON
		select COMM_UART
		select COMM_SLE
		select COMM_SLE_SERVER

	config DEVICE_HEALTH_TEMPERATURE
		bool "temperature"
		default y
		select COMM_FORMAT_PERSON
		select COMM_UART
		select COMM_SLE
		select COMM_SLE_SERVER
endif
```

## maker-desktop/device/trinity/Kconfig
```kconfig
if DEVICE_TRINITY
	config DEVICE_TRINITY_ASRPRO
		bool "asrpro"
		select COMM_FORMAT_CTRL
		select COMM_UART
		select COMM_SLE
		select COMM_SLE_SERVER

	config DEVICE_TRINITY_SOUND
		bool "sound"
		select COMM_FORMAT_CTRL
		select COMM_SLE
		select COMM_SLE_SERVER

	config DEVICE_TRINITY_VFD
		bool "vfd"
		select COMM_FORMAT_CTRL
		select COMM_UART
		select COMM_SLE
		select COMM_SLE_SERVER
endif
```

## maker-desktop/test/Kconfig
```kconfig
choice
	prompt "test"
	depends on TEST
	default TEST_KEYTEST

	config TEST_KEYTEST
		bool "keytest"
		select COMM_FORMAT_HID
		select COMM_SPI
		select COMM_UART
		select COMM_SLE
		select COMM_SLE_SERVER
		help
			[spi] & [uart] & [sle_s]

	menuconfig TEST_TMPTEST
		bool "tmptest"
		orsource "./tmptest/Kconfig"
endchoice
```

## maker-desktop/test/tmptest/Kconfig
```kconfig
if TEST_TMPTEST
	config TEST_TMPTEST_RECEIVER
		bool "receiver (sle_server test)"
		default y
		select COMM_UART
		select COMM_SLE
		select COMM_SLE_SERVER
endif
```

## patch/Kconfig
```kconfig
config ENABLE_SLAVE_SAMPLE
    bool "Enable the Sample of slave"
    default y
    depends on SAMPLE_ENABLE
if ENABLE_SLAVE_SAMPLE
    orsource "./slave/Kconfig"
endif

# config ENABLE_QUIZ_SAMPLE
#     bool "Enable the Sample of quiz"
#     default n
#     depends on SAMPLE_ENABLE





config ENABLE_PERIPHERAL_SAMPLE
    bool
    prompt "Enable the Sample of peripheral."
    default n
    depends on SAMPLE_ENABLE
    help
        This option means enable the sample of peripheral.

if ENABLE_PERIPHERAL_SAMPLE
    osource "application/samples/peripheral/Kconfig"
endif

config ENABLE_WIFI_SAMPLE
    bool
    prompt "Enable the Sample of WIFI."
    default n
    depends on SAMPLE_ENABLE
    help
        This option means enable the sample of WIFI.

if ENABLE_WIFI_SAMPLE
    osource "application/samples/wifi/Kconfig"
endif

config ENABLE_PRODUCTS_SAMPLE
    bool
    prompt "Enable the Sample of products."
    default n
    depends on SAMPLE_ENABLE
    help
        This option means enable the sample of products.

if ENABLE_PRODUCTS_SAMPLE
    osource "application/samples/products/Kconfig"
endif
```

## slave/Kconfig
```kconfig
orsource "./comm/Kconfig"





choice
    prompt "device / test"
    depends on ENABLE_MAKER_DESKTOP_SAMPLE
    default TEST

    config DEVICE
        bool "device"
        orsource "./device/Kconfig"

    config TEST
        bool "test"
        orsource "./test/Kconfig"
endchoice
```

## slave/device/deskaide/Kconfig
```kconfig
if DEVICE_DESKAIDE
	config DEVICE_DESKAIDE_ASRPRO
		bool "asrpro"
		default y
		select COMM_FORMAT_CTRL
		select COMM_UART
		select COMM_SLE
		select COMM_SLE_SERVER

	config DEVICE_DESKAIDE_SOUND
		bool "sound"
		default y
		select COMM_FORMAT_CTRL
		select COMM_SLE
		select COMM_SLE_SERVER

	config DEVICE_DESKAIDE_USBHUB
		bool "usbhub"
		default y
		select COMM_UART

	config DEVICE_DESKAIDE_VFD
		bool "vfd"
		default y
		select COMM_FORMAT_CTRL
		select COMM_UART
		select COMM_SLE
		select COMM_SLE_SERVER
endif
```

## slave/proj/Kconfig
```kconfig
orsource "./comm/Kconfig"





choice
    prompt "device / test"
    depends on ENABLE_SLAVE_SAMPLE
    default DEVICE

    config DEVICE
        bool "device"
        orsource "./device/Kconfig"

    config TEST
        bool "test"
        orsource "./test/Kconfig"
endchoice
```

## slave/test/Kconfig
```kconfig
choice
	prompt "test"
	depends on TEST
	default TEST_KEYTEST

	config TEST_KEYTEST
		bool "keytest"
		select COMM_FORMAT_HID
		select COMM_SPI
		select COMM_UART
		select COMM_SLE
		select COMM_SLE_SERVER
		select COMM_WIFI
		help
			[spi] & [uart] & [sle_s]

	menuconfig TEST_TMPTEST
		bool "tmptest"
		orsource "./tmptest/Kconfig"
endchoice
```

## slave/test/tmptest/Kconfig
```kconfig
if TEST_TMPTEST
	config TEST_TMPTEST_RECEIVER
		bool "receiver (sle_server test)"
		default y
		select COMM_UART
		select COMM_SLE
		select COMM_SLE_SERVER

	config TEST_TMPTEST_MULTI_THREAD
		bool "multi_thread"
		default n
		select COMM_UART
endif
```
